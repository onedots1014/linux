// SPDX-License-Identifier: (GPL-2.0+ OR BSD-3-Clause)
/*
* Copyright (C) 100ASK 2020 - All Rights Reserved
* Author: 100ask
* support: weidongshan@qq.com
*/

/dts-v1/;

#include "stm32mp157-onedots.dtsi"
#include "stm32mp157-onedots-pinctrl.dtsi"
#include "stm32mp157-onedots-board.dtsi"

/ {
	model = "Onedots STM32MP157C Development Board";
	compatible = "st,stm32mp157c-onedots-512d-v1", "st,stm32mp157";
	
	/* Package type specification to eliminate warnings */
	st,package = <STM32MP_PKG_AC>;
	
	aliases {
		serial0 = &uart4; /* Debug console */
	};

	chosen {
		stdout-path = "serial0:115200n8";
	};
};
